/*
 * Copyright (c) 2020 Pete Johanson
 *
 * SPDX-License-Identifier: MIT
 */

/ {

    iqs5xx_listener: iqs5xx_listener {
        compatible = "zmk,input-listener";
        status = "disabled";
        device = < &iqs5xx >;
    };

};

&pro_micro_i2c {
    status = "okay";

    iqs5xx: iqs5xx@74 {
        compatible = "azoteq,iqs5xx";
        reg = <0x74>;
        status = "okay";
        dr-gpios = <&pro_micro 1 (GPIO_ACTIVE_HIGH)>;
        sleep;
    };
};

/*
// other option ???
// Ask for this part and better review the documentation
&i2c1 {
    iqs5xx: iqs5xx@74 {
        compatible = "azoteq,iqs5xx";
        reg = <0x74>;
	// same pin like niceview
        dr-gpios = <&gpio0 1 GPIO_ACTIVE_LOW>;
        x-invert = <false>;
        y-invert = <false>;
        no-taps = <false>;
    };
};
*/
