## boards/shields/azoteq_adapter/Kconfig.defconfig
```kconfig
if SHIELD_AZOTEQ_ADAPTER_LEFT || SHIELD_AZOTEQ_ADAPTER_LEFT_ENABLE

config ZMK_SPLIT_ROLE_CENTRAL
    default y

endif

if SHIELD_AZOTEQ_ADAPTER_LEFT || SHIELD_AZOTEQ_ADAPTER_RIGHT || SHIELD_AZOTEQ_ADAPTER_LEFT_ENABLE

config ZMK_POINTING
    default y

config I2C
	default y

config ZMK_SPLIT
    default y

endif
```

## boards/shields/azoteq_adapter/Kconfig.shield
```kconfig
# Copyright (c) 2022 The ZMK Contributors
# SPDX-License-Identifier: MIT

config SHIELD_AZOTEQ_ADAPTER_LEFT
    def_bool $(shields_list_contains,azoteq_adapter_left)

config SHIELD_AZOTEQ_ADAPTER_LEFT_ENABLE
    def_bool $(shields_list_contains,azoteq_adapter_left_enable)

config SHIELD_AZOTEQ_ADAPTER_RIGHT
    def_bool $(shields_list_contains,azoteq_adapter_right)
```
